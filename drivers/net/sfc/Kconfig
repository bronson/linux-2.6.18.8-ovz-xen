## drivers/net/sfc/Kconfig
```kconfig
config SFC
	tristate "Solarflare Solarstorm SFC4000 support"
	depends on PCI && INET
	select MII
	help
	  This driver supports 10-gigabit Ethernet cards based on
	  the Solarflare Communications Solarstorm SFC4000 controller.

	  To compile this driver as a module, choose M here.  The module
	  will be called sfc.

config SFC_DEBUGFS
	bool "Solarflare Solarstorm SFC4000 debugging support"
	depends on SFC && DEBUG_FS
	default N
	help
	  This option creates an "sfc" subdirectory of debugfs with
	  debugging information for the SFC4000 driver.

	  If unsure, say N.

config SFC_MTD
	depends on SFC && MTD && MTD_PARTITIONS
	tristate "Solarflare Solarstorm SFC4000 flash/EEPROM support"
	help
	  This module exposes the on-board flash and/or EEPROM memory as
	  MTD devices (e.g. /dev/mtd1).  This makes it possible to upload a
	  new boot ROM to the NIC.

config SFC_RESOURCE
	depends on SFC && X86
	tristate "Solarflare Solarstorm SFC4000 resource driver"
	help
	  This module provides the SFC resource manager driver.
```

## grsecurity/Kconfig
```kconfig
#
# grecurity configuration
#

menu "Grsecurity"

config GRKERNSEC
	bool "Grsecurity"
	help
	  If you say Y here, you will be able to configure many features
	  that will enhance the security of your system.  It is highly
	  recommended that you say Y here and read through the help
	  for each option so that you fully understand the features and
	  can evaluate their usefulness for your machine.

menu "Executable Protections"
depends on GRKERNSEC

config GRKERNSEC_TPE
	bool "Trusted Path Execution (TPE)"
	help
	  If you say Y here, you will be able to choose a gid to add to the
	  supplementary groups of users you want to mark as "untrusted."
	  These users will not be able to execute any files that are not in
	  root-owned directories writable only by root.  If the sysctl option
	  is enabled, a sysctl option with name "tpe" is created.

config GRKERNSEC_TPE_ALL
	bool "Partially restrict non-root users"
	depends on GRKERNSEC_TPE
	help
	  If you say Y here, All non-root users other than the ones in the
	  group specified in the main TPE option will only be allowed to
	  execute files in directories they own that are not group or
	  world-writable, or in directories owned by root and writable only by
	  root.  If the sysctl option is enabled, a sysctl option with name
	  "tpe_restrict_all" is created.

config GRKERNSEC_TPE_INVERT
	bool "Invert GID option"
	depends on GRKERNSEC_TPE
	help
	  If you say Y here, the group you specify in the TPE configuration will
	  decide what group TPE restrictions will be *disabled* for.  This
	  option is useful if you want TPE restrictions to be applied to most
	  users on the system.

config GRKERNSEC_TPE_GID
	int "GID for untrusted users"
	depends on GRKERNSEC_TPE && !GRKERNSEC_TPE_INVERT
	default 1005
	help
	  If you have selected the "Invert GID option" above, setting this
	  GID determines what group TPE restrictions will be *disabled* for.
	  If you have not selected the "Invert GID option" above, setting this
	  GID determines what group TPE restrictions will be *enabled* for.
	  If the sysctl option is enabled, a sysctl option with name "tpe_gid"
	  is created.

config GRKERNSEC_TPE_GID
	int "GID for trusted users"
	depends on GRKERNSEC_TPE && GRKERNSEC_TPE_INVERT
	default 1005
	help
	  If you have selected the "Invert GID option" above, setting this
	  GID determines what group TPE restrictions will be *disabled* for.
	  If you have not selected the "Invert GID option" above, setting this
	  GID determines what group TPE restrictions will be *enabled* for.
	  If the sysctl option is enabled, a sysctl option with name "tpe_gid"
	  is created.

endmenu
menu "Sysctl support"
depends on GRKERNSEC && SYSCTL

config GRKERNSEC_SYSCTL
	bool "Sysctl support"
	help
	  If you say Y here, you will be able to change the options that
	  grsecurity runs with at bootup, without having to recompile your
	  kernel.  You can echo values to files in /proc/sys/kernel/grsecurity
	  to enable (1) or disable (0) various features.  All the sysctl entries
	  are mutable until the "grsec_lock" entry is set to a non-zero value.
	  All features enabled in the kernel configuration are disabled at boot
	  if you do not say Y to the "Turn on features by default" option.
	  All options should be set at startup, and the grsec_lock entry should
	  be set to a non-zero value after all the options are set.
	  *THIS IS EXTREMELY IMPORTANT*

config GRKERNSEC_SYSCTL_ON
	bool "Turn on features by default"
	depends on GRKERNSEC_SYSCTL
	help
	  If you say Y here, instead of having all features enabled in the
	  kernel configuration disabled at boot time, the features will be
	  enabled at boot time.  It is recommended you say Y here unless
	  there is some reason you would want all sysctl-tunable features to
	  be disabled by default.  As mentioned elsewhere, it is important
	  to enable the grsec_lock entry once you have finished modifying
	  the sysctl entries.

endmenu

menu "Logging Options"
depends on GRKERNSEC

config GRKERNSEC_FLOODTIME
	int "Seconds in between log messages (minimum)"
	default 10
	help
	  This option allows you to enforce the number of seconds between
	  grsecurity log messages.  The default should be suitable for most
	  people, however, if you choose to change it, choose a value small enough
	  to allow informative logs to be produced, but large enough to
	  prevent flooding.

config GRKERNSEC_FLOODBURST
	int "Number of messages in a burst (maximum)"
	default 4
	help
	  This option allows you to choose the maximum number of messages allowed
	  within the flood time interval you chose in a separate option.  The
	  default should be suitable for most people, however if you find that
	  many of your logs are being interpreted as flooding, you may want to
	  raise this value.

endmenu

endmenu
```

## kernel/Kconfig.fairsched
```kconfig
config SCHED_VCPU
	bool "VCPU scheduler support"
	default y
	help
	  VCPU scheduler support adds additional layer of abstraction
	  which allows to virtualize cpu notion and split physical cpus
	  and virtual cpus. This support allows to use CPU fair scheduler,
	  dynamically add/remove cpus to/from VPS and so on.

config FAIRSCHED
	bool "Fair CPU scheduler (EXPERIMENTAL)"
	depends on SCHED_VCPU
	default SCHED_VCPU
	help
	  Config option for Fair CPU scheduler (fairsched).
	  This option allows to group processes to scheduling nodes
	  which receive CPU proportional to their weight.
	  This is very important feature for process groups isolation and
	  QoS management.

	  If unsure, say N.
```

## kernel/ub/Kconfig
```kconfig
#
# User resources part (UBC)
#
# Copyright (C) 2005  SWsoft
# All rights reserved.
#
# Licensing governed by "linux/COPYING.SWsoft" file.

menu "User resources"

config USER_RESOURCE
	bool "Enable user resource accounting"
	default y
	help 
          This patch provides accounting and allows to configure
          limits for user's consumption of exhaustible system resources.
          The most important resource controlled by this patch is unswappable 
          memory (either mlock'ed or used by internal kernel structures and 
          buffers). The main goal of this patch is to protect processes
          from running short of important resources because of an accidental
          misbehavior of processes or malicious activity aiming to ``kill'' 
          the system. It's worth to mention that resource limits configured 
          by setrlimit(2) do not give an acceptable level of protection 
          because they cover only small fraction of resources and work on a 
          per-process basis.  Per-process accounting doesn't prevent malicious
          users from spawning a lot of resource-consuming processes.

config USER_RSS_ACCOUNTING
	bool "Account physical memory usage"
	default y
	depends on USER_RESOURCE
	help
          This allows to estimate per beancounter physical memory usage.
          Implemented alghorithm accounts shared pages of memory as well,
          dividing them by number of beancounter which use the page.

config UBC_IO_ACCT
	bool "Account disk IO"
	default y
	depends on USER_RSS_ACCOUNTING
	help
	  When on this option allows seeing disk IO activity caused by
	  tasks from each UB

config USER_SWAP_ACCOUNTING
	bool "Account swap usage"
	default y
	depends on USER_RESOURCE
	help
          This allows accounting of swap usage.

config USER_RESOURCE_PROC
	bool "Report resource usage in /proc"
	default y
	depends on USER_RESOURCE
	help
          Allows a system administrator to inspect resource accounts and limits.

config UBC_DEBUG
	bool "User resources debug features"
	default n
	depends on USER_RESOURCE
	help
	  Enables to setup debug features for user resource accounting

config UBC_DEBUG_IO
	bool "Debug IO accounting"
	default y
	depends on UBC_DEBUG && UBC_IO_ACCT
	help
	  Debugging for IO accointing.

config UBC_DEBUG_KMEM
	bool "Debug kmemsize with cache counters"
	default n
	depends on UBC_DEBUG
	help
	  Adds /proc/user_beancounters_debug entry to get statistics
	  about cache usage of each beancounter

config UBC_KEEP_UNUSED
	bool "Keep unused beancounter alive"
	default y
	depends on UBC_DEBUG
	help
	  If on, unused beancounters are kept on the hash and maxheld value
	  can be looked through.

config UBC_DEBUG_ITEMS
	bool "Account resources in items rather than in bytes"
	default y
	depends on UBC_DEBUG
	help
	  When true some of the resources (e.g. kmemsize) are accounted
	  in items instead of bytes.

config UBC_UNLIMITED
	bool "Use unlimited ubc settings"
	default y
	depends on UBC_DEBUG
	help
	  When ON all limits and barriers are set to max values.

config UBC_IO_PRIO
	bool "UBC I/O priority"
	default y
	depends on UBC_IO_ACCT && IOSCHED_CFQ
	help
	  This option controls whether to build CFQ I/O scheduler
	  with support of UBC I/O priority.
endmenu
```
